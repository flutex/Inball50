## config/west.yml
```yaml
manifest:
  remotes:
    - name: zmkfirmware
      url-base: https://github.com/zmkfirmware
    - name: sekigon-gonnoc
      url-base: https://github.com/sekigon-gonnoc
    - name: hsgw
      url-base: https://github.com/hsgw
    - name: badjeff
      url-base: https://github.com/badjeff  
  projects:
    - name: zmk
      remote: zmkfirmware
      revision: main
      import: app/west.yml
    - name: zmk-driver-paw3222
      remote: sekigon-gonnoc
      revision: main
    - name: zmk-feature-sensor_rotation
      remote: hsgw
      revision: main
      path: modules/zmk-feature-sensor_rotation
    - name: zmk-input-processor-report-rate-limit
      remote: badjeff
      revision: main
  self:
    path: config
```
